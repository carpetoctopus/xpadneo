## hid-xpadneo-1/Kconfig
```kconfig
config XPADNEO
	tristate "Xbox Wireless Controller Driver"
	help
	  Xbox wireless controller support.
```

## hid-xpadneo-2/Kconfig
```kconfig
config XPADNEO
	tristate "Xbox Wireless Controller Driver"
	select HID
	help
	  Xbox wireless controller support.
```

## hid-xpadneo/Kconfig
```kconfig
config HID_XPADNEO
        tristate "Xbox Wireless Controller Driver"
        select POWER_SUPPLY
        select HID
        select CRC16
        help
          Xbox wireless controller support.
```
